## deps/buildroot/configs/venom_basepvh_defconfig
```kconfig
BR2_x86_64=y
BR2_x86_core_avx2=y
BR2_OPTIMIZE_2=y
BR2_TOOLCHAIN_EXTERNAL=y
BR2_TOOLCHAIN_EXTERNAL_PATH="/home/dev/xtools/venom/x86_64-buildroot-linux-gnu"
BR2_TOOLCHAIN_EXTERNAL_CUSTOM_PREFIX="x86_64-buildroot-linux-gnu"
BR2_TOOLCHAIN_EXTERNAL_GCC_8=y
BR2_TOOLCHAIN_EXTERNAL_HEADERS_5_1=y
BR2_TOOLCHAIN_EXTERNAL_CUSTOM_GLIBC=y
BR2_TOOLCHAIN_EXTERNAL_CXX=y
BR2_INIT_SYSTEMD=y
BR2_TARGET_GENERIC_ROOT_PASSWD="asdf"
# BR2_TARGET_GENERIC_GETTY is not set
BR2_TARGET_LOCALTIME="America/Denver"
BR2_LINUX_KERNEL=y
BR2_LINUX_KERNEL_CUSTOM_GIT=y
BR2_LINUX_KERNEL_CUSTOM_REPO_URL="git@gitlab.ainfosec.com:bareflank/linux.git"
BR2_LINUX_KERNEL_CUSTOM_REPO_VERSION="venom"
BR2_LINUX_KERNEL_USE_CUSTOM_CONFIG=y
BR2_LINUX_KERNEL_CUSTOM_CONFIG_FILE="/home/dev/bf/microv/deps/linux/.config"
BR2_LINUX_KERNEL_VMLINUX=y
# BR2_PACKAGE_BUSYBOX is not set
BR2_TARGET_ROOTFS_TAR_GZIP=y
```
